## xiaozhi-esp32/sdkconfig.defaults.esp32
```kconfig
CONFIG_ESPTOOLPY_FLASHSIZE_4MB=y
CONFIG_PARTITION_TABLE_CUSTOM=y
CONFIG_PARTITION_TABLE_CUSTOM_FILENAME="partitions/v2/4m.csv"
CONFIG_SR_WN_WN9_NIHAOXIAOZHI_TTS=y
CONFIG_ESP_TASK_WDT_TIMEOUT_S=20

# Classic ESP32 has less RAM; default sys_evt stack (2304) overflows during WiFi connect
CONFIG_ESP_SYSTEM_EVENT_TASK_STACK_SIZE=4096

# Local WitBlox server on your laptop (change IP if your LAN address changes)
CONFIG_OTA_URL="http://192.168.0.106:8003/xiaozhi/ota/"
```
